## main/Kconfig.projbuild
```kconfig
menu "CAR"

config CAR_PORT
    int "Port"
    range 0 65535
    default 1508
    help
        Local port the example server will listen on.
        
config STORE_HISTORY
    bool "Store command history in flash"
    default y
    help
        Linenoise line editing library provides functions to save and load
        command history. If this option is enabled, initalizes a FAT filesystem
        and uses it to store command history.

endmenu

menu "WiFi Configuration"

    config ESP_WIFI_SSID
        string "WiFi SSID"
        default "myssid"
        help
            SSID (network name) for the example to connect to.

    config ESP_WIFI_PASSWORD
        string "WiFi Password"
        default "mypassword"
        help
            WiFi password (WPA or WPA2) for the example to use.

    config ESP_MAX_STA_CONN
        int "Maximal STA connections"
        default 4
        help
            Max number of the STA connects to AP.
endmenu
```
